## bsp_files/conf/bblayers.conf
```bitbake
# POKY_BBLAYERS_CONF_VERSION is increased each time build/conf/bblayers.conf
# changes incompatibly
POKY_BBLAYERS_CONF_VERSION = "2"

BBPATH = "${TOPDIR}"
BBFILES ?= ""

OEROOT := "${TOPDIR}/../sources/poky"

# In our BSPs active layers are defined by the manifest.xml for all BSPs. The
# bblayers.conf gets created by the init_bblayers.py script.
BBLAYERS ?= " \
  ${TOPDIR}/../sources/meta-scales-leviathan \
  "
BBLAYERS += "\
  ${OEROOT}/../poky/meta \
  ${OEROOT}/../poky/meta-poky \
  ${OEROOT}/../meta-openembedded/meta-oe \
  ${OEROOT}/../meta-openembedded/meta-networking \
  ${OEROOT}/../meta-openembedded/meta-python \
  ${OEROOT}/../meta-openembedded/meta-multimedia \
  ${OEROOT}/../meta-openembedded/meta-filesystems \
  ${OEROOT}/../meta-openembedded/meta-perl \
  ${OEROOT}/../meta-openembedded/meta-gnome \
  ${OEROOT}/../meta-browser/meta-chromium \
  ${OEROOT}/../meta-clang \
  ${OEROOT}/../meta-freescale \
  ${OEROOT}/../meta-freescale-3rdparty \
  ${OEROOT}/../meta-freescale-distro \
  ${OEROOT}/../meta-arm/meta-arm \
  ${OEROOT}/../meta-arm/meta-arm-toolchain \
  ${OEROOT}/../meta-qt6 \
  ${OEROOT}/../meta-security \
  ${OEROOT}/../meta-security/meta-tpm \
  ${OEROOT}/../meta-virtualization \
  ${OEROOT}/../meta-imx/meta-imx-bsp \
  ${OEROOT}/../meta-imx/meta-imx-sdk \
  ${OEROOT}/../meta-imx/meta-imx-ml \
  ${OEROOT}/../meta-nxp-demo-experience \
  ${OEROOT}/../meta-rauc \
  ${OEROOT}/../meta-phytec \
  ${OEROOT}/../meta-ampliphy \
  ${OEROOT}/../meta-qt6-phytec \
  "
```
